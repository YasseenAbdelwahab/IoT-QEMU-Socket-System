## yocto/meta-iotclient/conf/layer.conf
```bitbake
# We have a conf and classes directory, add to BBPATH
BBPATH .= ":${LAYERDIR}"

# We have recipes-* directories, add to BBFILES
BBFILES += "${LAYERDIR}/recipes-*/*/*.bb \
            ${LAYERDIR}/recipes-*/*/*.bbappend"

BBFILE_COLLECTIONS += "meta-iotclient"
BBFILE_PATTERN_meta-iotclient = "^${LAYERDIR}/"
BBFILE_PRIORITY_meta-iotclient = "6"

LAYERDEPENDS_meta-iotclient = "core"
LAYERSERIES_COMPAT_meta-iotclient = "kirkstone"
```
